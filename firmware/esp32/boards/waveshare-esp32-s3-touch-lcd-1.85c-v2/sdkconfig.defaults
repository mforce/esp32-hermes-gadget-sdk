## firmware/esp32/boards/waveshare-esp32-s3-touch-lcd-1.85c-v2/sdkconfig.defaults
```kconfig
# Experimental Waveshare ESP32-S3-Touch-LCD-1.85C Rev2.0 only.
CONFIG_IDF_TARGET="esp32s3"
# CONFIG_ESPTOOLPY_FLASHSIZE_4MB is not set
CONFIG_ESPTOOLPY_FLASHSIZE_16MB=y
CONFIG_SPIRAM=y
CONFIG_SPIRAM_MODE_OCT=y
CONFIG_SPIRAM_SPEED_80M=y
CONFIG_SPIRAM_USE_MALLOC=y
CONFIG_SPIRAM_IGNORE_NOTFOUND=y
CONFIG_ESP_DEFAULT_CPU_FREQ_MHZ_240=y
# CONFIG_ESP_CONSOLE_UART_DEFAULT is not set
CONFIG_ESP_CONSOLE_USB_SERIAL_JTAG=y
CONFIG_HG_BOARD_WS_ESP32S3_TOUCH_LCD_185C_V2=y
```
